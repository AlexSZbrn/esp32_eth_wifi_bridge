## sdkconfig.defaults.w5500_s3
```kconfig
# W5500 SPI Ethernet + ESP32-S3 (Waveshare ESP32-S3-ETH)
#
# Wiring (из официальной схемы Waveshare ESP32-S3-ETH):
# W5500 MOSI -> GPIO11   W5500 MISO -> GPIO12
# W5500 SCLK -> GPIO13   W5500 CS   -> GPIO14
# W5500 INT  -> GPIO10   W5500 RST  -> GPIO9
#
# PoE: вставить PoE-модуль в разъём на плате (IEEE 802.3af).
# Никакого изменения кода не требует — питание прозрачно.
#
# Build:
#   idf.py set-target esp32s3 -B build_w5500_s3 \
#     -D SDKCONFIG=sdkconfig.w5500_s3 \
#     -D SDKCONFIG_DEFAULTS="sdkconfig.defaults;sdkconfig.defaults.w5500_s3" \
#     build
#
# Flash/monitor:
#   idf.py -B build_w5500_s3 -p /dev/ttyACM0 flash monitor

# -----------------------------------------------------------------------
# Uplink driver
# -----------------------------------------------------------------------

CONFIG_ETH_UPLINK_W5500=y

CONFIG_ETH_USE_SPI_ETHERNET=y
CONFIG_ETH_SPI_ETHERNET_W5500=y

# -----------------------------------------------------------------------
# W5500 pin assignments
# -----------------------------------------------------------------------

# SPI2_HOST = 1 (единственный вариант с GPIO-matrix-роутингом на S3)
CONFIG_ETH_SPI_HOST=1
CONFIG_ETH_SPI_MOSI_GPIO=11
CONFIG_ETH_SPI_MISO_GPIO=12
CONFIG_ETH_SPI_SCLK_GPIO=13
CONFIG_ETH_SPI_CS_GPIO=14
CONFIG_ETH_SPI_INT_GPIO=10
CONFIG_ETH_SPI_RST_GPIO=9

# W5500 поддерживает до 80 МГц; 40 МГц — надёжный максимум без экранировки
CONFIG_ETH_SPI_CLOCK_MHZ=40

# -----------------------------------------------------------------------
# Console
# -----------------------------------------------------------------------

# USB-C порт на плате = USB Serial/JTAG (/dev/ttyACM0), как у C3 SuperMini
CONFIG_ESP_CONSOLE_USB_SERIAL_JTAG=y
# CONFIG_ESP_CONSOLE_UART_DEFAULT is not set

# -----------------------------------------------------------------------
# CPU
# -----------------------------------------------------------------------

# S3 dual-core, max 240 МГц (у C3 было только 160)
CONFIG_ESP_DEFAULT_CPU_FREQ_MHZ_240=y
# CONFIG_ESP_DEFAULT_CPU_FREQ_MHZ_160 is not set

# -----------------------------------------------------------------------
# Task watchdog
# -----------------------------------------------------------------------

# W5500 SPI-поллинг может голодать IDLE-таски — отключаем WDT на обоих ядрах
# (на C3 одно ядро, здесь два)
CONFIG_ESP_TASK_WDT_CHECK_IDLE_TASK_CPU0=n
CONFIG_ESP_TASK_WDT_CHECK_IDLE_TASK_CPU1=n

# Поднимаем приоритет main-таска чтобы REPL не вытеснялся ETH MAC (prio 18)
CONFIG_ESP_MAIN_TASK_PRIO=5

# -----------------------------------------------------------------------
# IRAM / performance
# -----------------------------------------------------------------------

# SPI hot path в IRAM — нет промахов кэша при конкуренции W5500 и WiFi
CONFIG_SPI_MASTER_IN_IRAM=y
CONFIG_SPI_MASTER_ISR_IN_IRAM=y

# lwIP hot path в IRAM
CONFIG_LWIP_IRAM_OPTIMIZATION=y

# Оптимизировать по скорости
CONFIG_COMPILER_OPTIMIZATION_PERF=y
# CONFIG_COMPILER_OPTIMIZATION_SIZE is not set

# -----------------------------------------------------------------------
# WiFi buffers
# -----------------------------------------------------------------------

# Для 1 клиента достаточно: экономим ~40 KB heap
CONFIG_ESP_WIFI_STATIC_RX_BUFFER_NUM=6
CONFIG_ESP_WIFI_DYNAMIC_RX_BUFFER_NUM=16
CONFIG_ESP_WIFI_DYNAMIC_TX_BUFFER_NUM=16
# RX_BA_WIN <= 2 * STATIC_RX_BUFFER_NUM (6*2=12, берём 6 как в C3-варианте)
CONFIG_ESP_WIFI_RX_BA_WIN=6

# -----------------------------------------------------------------------
# TCP windows
# -----------------------------------------------------------------------

# 2×MSS (2880) — достаточно для лёгкой нагрузки одного клиента
CONFIG_LWIP_TCP_SND_BUF_DEFAULT=2880
CONFIG_LWIP_TCP_WND_DEFAULT=2880
```
